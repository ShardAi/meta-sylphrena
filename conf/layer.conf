## conf/layer.conf
```bitbake
# We have a conf and classes directory, add to BBPATH
BBPATH .= ":${LAYERDIR}"

# We have recipes-* directories, add to BBFILES
BBFILES += "${LAYERDIR}/recipes-*/*/*.bb \
	${LAYERDIR}/recipes-*/*/*.bbappend"

LAYERSERIES_COMPAT_sylphrena-core = "thud"
LAYERSERIES_COMPAT_sylphrena-input = "thud"
BBFILE_COLLECTIONS += "sylphrena-core"
BBFILE_COLLECTIONS += "sylphrena-input"
BBFILE_PATTERN_sylphrena-core = "^${LAYERDIR}/"
BBFILE_PRIORITY_sylphrena-core = "10"
BBFILE_PATTERN_sylphrena-input = "^${LAYERDIR}/"
BBFILE_PRIORITY_sylphrena-input = "10"
```
